## arch/arm/Kconfig
```kconfig
menu "ARM architecture"
	depends on ARM

config SYS_ARCH
	default "arm"

config ARM64
	bool
	select PHYS_64BIT
	select SYS_CACHE_SHIFT_6

config DMA_ADDR_T_64BIT
	bool
	default y if ARM64

config HAS_VBAR
	bool

config HAS_THUMB2
	bool

config CPU_ARM720T
	bool
	select SYS_CACHE_SHIFT_5

config CPU_ARM920T
	bool
	select SYS_CACHE_SHIFT_5

config CPU_ARM926EJS
	bool
	select SYS_CACHE_SHIFT_5

config CPU_ARM946ES
	bool
	select SYS_CACHE_SHIFT_5

config CPU_ARM1136
	bool
	select SYS_CACHE_SHIFT_5

config CPU_ARM1176
	bool
	select HAS_VBAR
	select SYS_CACHE_SHIFT_5

config CPU_V7
	bool
	select HAS_VBAR
	select HAS_THUMB2
	select SYS_CACHE_SHIFT_6

config CPU_V7M
	bool
	select HAS_THUMB2
	select SYS_CACHE_SHIFT_5

config CPU_PXA
	bool
	select SYS_CACHE_SHIFT_5

config CPU_SA1100
	bool
	select SYS_CACHE_SHIFT_5

config SYS_CPU
	default "arm720t" if CPU_ARM720T
	default "arm920t" if CPU_ARM920T
	default "arm926ejs" if CPU_ARM926EJS
	default "arm946es" if CPU_ARM946ES
	default "arm1136" if CPU_ARM1136
	default "arm1176" if CPU_ARM1176
	default "armv7" if CPU_V7
	default "armv7m" if CPU_V7M
	default "pxa" if CPU_PXA
	default "sa1100" if CPU_SA1100
	default "armv8" if ARM64

config SYS_ARM_ARCH
	int
	default 4 if CPU_ARM720T
	default 4 if CPU_ARM920T
	default 5 if CPU_ARM926EJS
	default 5 if CPU_ARM946ES
	default 6 if CPU_ARM1136
	default 6 if CPU_ARM1176
	default 7 if CPU_V7
	default 7 if CPU_V7M
	default 5 if CPU_PXA
	default 4 if CPU_SA1100
	default 8 if ARM64

config SYS_CACHE_SHIFT_5
	bool

config SYS_CACHE_SHIFT_6
	bool

config SYS_CACHE_SHIFT_7
	bool

config SYS_CACHELINE_SIZE
	int
	default 128 if SYS_CACHE_SHIFT_7
	default 64 if SYS_CACHE_SHIFT_6
	default 32 if SYS_CACHE_SHIFT_5

config SEMIHOSTING
	bool "support boot from semihosting"
	help
	  In emulated environments, semihosting is a way for
	  the hosted environment to call out to the emulator to
	  retrieve files from the host machine.

config SYS_L2CACHE_OFF
	bool "L2cache off"
	help
	  If SoC does not support L2CACHE or one do not want to enable
	  L2CACHE, choose this option.

config ENABLE_ARM_SOC_BOOT0_HOOK
	bool "prepare BOOT0 header"
	help
	  If the SoC's BOOT0 requires a header area filled with (magic)
	  values, then choose this option, and create a define called
	  ARM_SOC_BOOT0_HOOK which contains the required assembler
	  preprocessor code.

choice
	prompt "Target select"
	default TARGET_HIKEY

config TARGET_SMDK2410
	bool "Support smdk2410"
	select CPU_ARM920T
	select SUPPORT_SPL

config TARGET_FS2416
	bool "Support fs2416"
	select CPU_ARM926EJS
	select SUPPORT_SPL
	select SPL

endchoice

source "arch/arm/cpu/armv7/Kconfig"

source "board/samsung/smdk2410/Kconfig"
source "board/samsung/fs2416/Kconfig"

source "arch/arm/Kconfig.debug"

endmenu
```

## board/samsung/fs2416/Kconfig
```kconfig
if TARGET_FS2416

config SYS_BOARD
	default "fs2416"

config SYS_VENDOR
	default "samsung"

config SYS_SOC
	default "s3c2416"

config SYS_CONFIG_NAME
	default "fs2416"

endif
```
